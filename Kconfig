## Kconfig
```kconfig
mainmenu "MaixCDK configuration, platform: ${PLATFORM}"

menu "SDK Components Configuration"
	osource "${SDK_PATH}/components/*/Kconfig"
endmenu

menu "3rd party Components Configuration"
	osource "${SDK_PATH}/components/3rd_party/*/Kconfig"
endmenu

menu "external device Components Configuration"
	osource "${SDK_PATH}/components/ext_devs/*/Kconfig"
endmenu

menu "Extra Components Configuration"
	osource "${MAIXCDK_EXTRA_COMPONENTS_PATH}/*/Kconfig"
	# components released with python package format, installed by pip install maixcdk-xxxx
	# site-package directory is `python -c "import site;print(site.getusersitepackages())"`
	osource "${PY_PKG_COMPONENTS_PATH}/*/Kconfig"
	osource "${PY_USR_PKG_COMPONENTS_PATH}/*/Kconfig"
endmenu

menu "Project Components Configuration"
	osource "${PROJECT_PATH}/../components/*/Kconfig"
	osource "${PROJECT_PATH}/*/Kconfig"
	osource "${PROJECT_PATH}/components/*/Kconfig"
endmenu

config LIBS_LINK_STATIC
	bool "Link libraries statically"
	default n
	help
	  Link libraries statically, link all code to one executable file.

config COMPONENTS_COMPILE_FROM_SOURCE
	bool "All components compile from source instead of using prebuilt libraries or local libraries"
	default n
	help
	  All components compile from source instead of using prebuilt libraries or local libraries.
```

## components/3rd_party/FFmpeg/Kconfig
```kconfig
menu "ffmpeg component configuration"
    menu "FFMPEG version"
        config FFMPEG_VERSION_MAJOR
            int "FFMPEG version major"
            default 4 if PLATFORM = "maixcam"
            default 6 if PLATFORM = "maixcam2"
        config FFMPEG_VERSION_MINOR
            int "FFMPEG version minor"
            default 4 if PLATFORM = "maixcam"
            default 1 if PLATFORM = "maixcam2"
        config FFMPEG_VERSION_PATCH
            int "FFMPEG version patch"
            default 4 if PLATFORM = "maixcam"
            default 1 if PLATFORM = "maixcam2"
        config FFMPEG_COMPILED_VERSION
            int "FFMPEG compiled version"
            default 2 if PLATFORM = "maixcam"
            default 1 if PLATFORM = "maixcam2"
    endmenu
endmenu
```

## components/3rd_party/RtspServer/Kconfig
```kconfig
menu "RtspServer component configuration"
    menu "RtspServer version"
        config RTSP_SERVER_VERSION_MAJOR
            int "RtspServer version major"
            default 1
        config RTSP_SERVER_VERSION_MINOR
            int "RtspServer version minor"
            default 0
        config RTSP_SERVER_VERSION_PATCH
            int "RtspServer version patch"
            default 0
    endmenu
endmenu
```

## components/3rd_party/brotli/Kconfig
```kconfig
# BROTLI version major minor patch
menu "BROTLI version"
config BROTLI_VERSION_MAJOR
    int "BROTLI package major version"
    default 1
    help
      BROTLI package major version, 0 means auto select according to board

config BROTLI_VERSION_MINOR
    int "BROTLI package minor version"
    default 1
    help
      BROTLI package minor version

config BROTLI_VERSION_PATCH
    int "BROTLI package patch version"
    default 0
    help
      BROTLI package patch version
endmenu
```

## components/3rd_party/freetype/Kconfig
```kconfig
# freetype version major minor patch
menu "freetype version"
config FREETYPE_VERSION_MAJOR
    int "freetype package major version"
    default 2
    help
      freetype package major version, 0 means auto select according to board

config FREETYPE_VERSION_MINOR
    int "freetype package minor version"
    default 13
    help
      freetype package minor version

config FREETYPE_VERSION_PATCH
    int "freetype package patch version"
    default 2
    help
      freetype package patch version
endmenu
```

## components/3rd_party/harfbuzz/Kconfig
```kconfig
# harfbuzz version major minor patch
menu "harfbuzz version"
config HARFBUZZ_VERSION_MAJOR
    int "harfbuzz package major version"
    default 8
    help
      harfbuzz package major version, 0 means auto select according to board

config HARFBUZZ_VERSION_MINOR
    int "harfbuzz package minor version"
    default 2
    help
      harfbuzz package minor version

config HARFBUZZ_VERSION_PATCH
    int "harfbuzz package patch version"
    default 1
    help
      harfbuzz package patch version
endmenu
```

## components/3rd_party/kaldi-native-fbank/Kconfig
```kconfig
menu "kaldi native fbank component configuration"
    menu "KALDI_NATIVE_FBANK version"
        config KALDI_NATIVE_FBANK_VERSION_MAJOR
            int "KALDI_NATIVE_FBANK version major"
            default 1 if PLATFORM = "maixcam"
            default 1 if PLATFORM = "maixcam2"
        config KALDI_NATIVE_FBANK_VERSION_MINOR
            int "KALDI_NATIVE_FBANK version minor"
            default 20 if PLATFORM = "maixcam"
            default 20 if PLATFORM = "maixcam2"
        config KALDI_NATIVE_FBANK_VERSION_PATCH
            int "KALDI_NATIVE_FBANK version patch"
            default 1 if PLATFORM = "maixcam"
            default 1 if PLATFORM = "maixcam2"
    endmenu
endmenu
```

## components/3rd_party/libdatachannel/Kconfig
```kconfig
menu "libdatachannel component configuration"
    menu "LIBDATACHANNEL version"
        config LIBDATACHANNEL_VERSION_MAJOR
            int "LIBDATACHANNEL version major"
            default 0 if PLATFORM = "maixcam"
            default 0 if PLATFORM = "maixcam2"
        config LIBDATACHANNEL_VERSION_MINOR
            int "LIBDATACHANNEL version minor"
            default 22 if PLATFORM = "maixcam"
            default 22 if PLATFORM = "maixcam2"
        config LIBDATACHANNEL_VERSION_PATCH
            int "LIBDATACHANNEL version patch"
            default 4 if PLATFORM = "maixcam"
            default 4 if PLATFORM = "maixcam2"
    endmenu
endmenu
```

## components/3rd_party/libjuice/Kconfig
```kconfig
menu "libjuice component configuration"
    menu "LIBJUICE version"
        config LIBJUICE_VERSION_MAJOR
            int "LIBJUICE version major"
            default 1 if PLATFORM = "maixcam"
            default 1 if PLATFORM = "maixcam2"
        config LIBJUICE_VERSION_MINOR
            int "LIBJUICE version minor"
            default 5 if PLATFORM = "maixcam"
            default 5 if PLATFORM = "maixcam2"
        config LIBJUICE_VERSION_PATCH
            int "LIBJUICE version patch"
            default 8 if PLATFORM = "maixcam"
            default 8 if PLATFORM = "maixcam2"
    endmenu
endmenu
```

## components/3rd_party/libsrtp/Kconfig
```kconfig
menu "libsrtp component configuration"
    menu "LIBSRTP version"
        config LIBSRTP_VERSION_MAJOR
            int "LIBSRTP version major"
            default 2 if PLATFORM = "maixcam"
            default 2 if PLATFORM = "maixcam2"
        config LIBSRTP_VERSION_MINOR
            int "LIBSRTP version minor"
            default 6 if PLATFORM = "maixcam"
            default 6 if PLATFORM = "maixcam2"
        config LIBSRTP_VERSION_PATCH
            int "LIBSRTP version patch"
            default 0 if PLATFORM = "maixcam"
            default 0 if PLATFORM = "maixcam2"
    endmenu
endmenu
```

## components/3rd_party/lvgl/Kconfig
```kconfig
menu "gui_lvgl component configuration"
    menu "LVGL version"
        config LVGL_VERSION_MAJOR
            int "LVGL version major"
            default 9
        config LVGL_VERSION_MINOR
            int "LVGL version minor"
            default 1
        config LVGL_VERSION_PATCH
            int "LVGL version patch"
            default 0
    endmenu

    config LVGL_USE_MOUSE
        bool "Use mouse(touchpad) input"
        default y
        help
            Enable mouse input support.

    config LVGL_SHOW_PERFORMANCE
        bool "Show performance monitor"
        default n
        help
            Show performance monitor on the screen.
    osource "${SDK_PATH}/dl/extracted/lvgl_srcs/lvgl/Kconfig"
endmenu
```

## components/3rd_party/maixcam2_msp/Kconfig
```kconfig
# AX620e MSP Options, only for maixcam2 platform
if PLATFORM = "maixcam2"
menu "AX620E MSP Options"

config AX620E_MSP_ENABLE_NPU_LIB
    bool "Enable NPU library"
    default n
    help
      Enable NPU library

config AX620E_MSP_ENABLE_VO_LIB
    bool "Enable vo library"
    default n
    help
      Enable vo library

config AX620E_MSP_ENABLE_SENSOR_LIB
    bool "Enable maixcam2 official sensor library"
    default n
    help
      Enable sensor library

config AX620E_MSP_ENABLE_EXTRA_SENSOR_LIB
    bool "Enable extra sensor library, maybe no ISP ajustment"
    default n
    help
      Enable extra sensor library

config AX620E_MSP_ENABLE_AUDIO_LIB
    bool "Enable audio library"
    default n
    help
      Enable audio library

config AX620E_MSP_ENABLE_IVES_LIB
    bool "Enable IVES(Intelligent Video Extension System) library"
    default n
    help
      Enable IVES(Intelligent Video Extension System) library

config AX620E_MSP_ENABLE_SKEL_LIB
    bool "Enable SKEL(Skeleton Artificial Intelligent Algorithm) library"
    default n
    help
      Enable SKEL(Skeleton Artificial Intelligent Algorithm) library

config AX620E_MSP_ENABLE_OPAL_LIB
    bool "Enable OPAL(Operator Abstract Layer) library"
    default n
    help
      Enable OPAL(Operator Abstract Layer) library

config AX620E_MSP_ENABLE_EFUSE_LIB
    bool "Enable efuse library"
    default n
    help
      Enable efuse library

config AX620E_MSP_ENABLE_GZIP_LIB
    bool "Enable hardware acceleration API for gzip"
    default n
    help
      Enable hardware acceleration API for gzip

config AX620E_MSP_ENABLE_EXTRA_LIB
    bool "Enable extra libraries"
    default n
    help
      Enable extra libraries


endmenu
endif
```

## components/3rd_party/marisa-trie/Kconfig
```kconfig
menu "marisa-trie component configuration"
    menu "MARISA_TRIE version"
        config MARISA_TRIE_VERSION_MAJOR
            int "MARISA_TRIE version major"
            default 0 if PLATFORM = "maixcam"
            default 0 if PLATFORM = "maixcam2"
        config MARISA_TRIE_VERSION_MINOR
            int "MARISA_TRIE version minor"
            default 2 if PLATFORM = "maixcam"
            default 2 if PLATFORM = "maixcam2"
        config MARISA_TRIE_VERSION_PATCH
            int "MARISA_TRIE version patch"
            default 6 if PLATFORM = "maixcam"
            default 6 if PLATFORM = "maixcam2"
    endmenu
endmenu
```

## components/3rd_party/media_server/Kconfig
```kconfig
# media_server version major minor patch
menu "media_server version"
config MEDIA_SERVER_VERSION_MAJOR
    int "media_server package major version"
    default 1
    help
      media_server package major version, 0 means auto select according to board

config MEDIA_SERVER_VERSION_MINOR
    int "media_server package minor version"
    default 0
    help
      media_server package minor version

config MEDIA_SERVER_VERSION_PATCH
    int "media_server package patch version"
    default 2
    help
      media_server package patch version
endmenu
```

## components/3rd_party/omv/Kconfig
```kconfig
# omv version major minor patch
menu "omv version"
config OMV_VERSION_MAJOR
    int "omv package major version"
    default 1
    help
      omv package major version, 0 means auto select according to board

config OMV_VERSION_MINOR
    int "omv package minor version"
    default 0
    help
      omv package minor version

config OMV_VERSION_PATCH
    int "omv package patch version"
    default 10
    help
      omv package patch version

config OMV_OPTIMIZE_ENABLE
    bool "omv optimize enable"
    default n if PLATFORM = "maixcam"
    default y if PLATFORM = "maixcam2"
    help
      omv optimize
endmenu
```

## components/3rd_party/onnxruntime/Kconfig
```kconfig
# onnxruntime version major minor patch
menu "onnxruntime version"
config ONNXRUNTIME_VERSION_MAJOR
    int "onnxruntime package major version"
    default 1 if PLATFORM = "maixcam"
    default 1 if PLATFORM = "maixcam2"
    help
      onnxruntime package major version, 0 means auto select according to board

config ONNXRUNTIME_VERSION_MINOR
    int "onnxruntime package minor version"
    default 20 if PLATFORM = "maixcam"
    default 22 if PLATFORM = "maixcam2"
    help
      onnxruntime package minor version

config ONNXRUNTIME_VERSION_PATCH
    int "onnxruntime package patch version"
    default 1 if PLATFORM = "maixcam"
    default 0 if PLATFORM = "maixcam2"
    help
      onnxruntime package patch version
endmenu
```

## components/3rd_party/opencv/Kconfig
```kconfig
config OPENCV_COMPILE_FROM_SOURCE
	bool "OpenCV compile from source instead of local libraries"
	default n
	help
	  Opencv compile from source instead of using prebuilt libraries or local libraries, use sudo apt install libopencv-dev to install opencv libraries first.

config OPENCV_DIR
	string "OpenCVConfig.cmake file's directory"
	default ""
	help
	  manually set opencv directory, for example /usr/lib/x86_64-linux-gnu/cmake/opencv4, if not set, will auto find it.
```

## components/3rd_party/openssl/Kconfig
```kconfig
menu "OpenSSL"
  config OPENSSL_COMPILE_FROM_SOURCE
      bool "compile openssl from souce code"
      default n
      help
        compile openssl from source code, or use system libs
endmenu
```

## components/3rd_party/python3/Kconfig
```kconfig
# Python version major minor patch
menu "Python Configs"
  config PYTHON_COMPILE_FROM_SOURCE
      bool "compile python from source code"
      default false
      help
        Compile Python lib from source code
  menu "Python version"

    config PYTHON_VERSION_MAJOR
        int "python package major version"
        default 0
        help
          Python package major version, 0 means auto select according to board

    config PYTHON_VERSION_MINOR
        int "python package minor version"
        default 0
        help
          Python package minor version

    config PYTHON_VERSION_PATCH
        int "python package patch version"
        default 0
        help
          Python package patch version
  endmenu
endmenu
```

## components/3rd_party/quirc/Kconfig
```kconfig
# quirc version major minor patch
menu "quirc version"
config QUIRC_VERSION_MAJOR
    int "quirc package major version"
    default 1
    help
      quirc package major version, 0 means auto select according to board

config QUIRC_VERSION_MINOR
    int "quirc package minor version"
    default 2
    help
      quirc package minor version
endmenu
```

## components/3rd_party/sdl/Kconfig
```kconfig
# SDL version major minor patch
menu "SDL version"
  config SDL_VERSION_MAJOR
      int "SDL package major version"
      default 2
      help
        SDL package major version, 0 means auto select according to board

  config SDL_VERSION_MINOR
      int "SDL package minor version"
      default 28
      help
        SDL package minor version

  config SDL_VERSION_PATCH
      int "SDL package patch version"
      default 4
      help
        SDL package patch version
endmenu
```

## components/3rd_party/sunxi_mpp/Kconfig
```kconfig
# SUNXI_MPP version major minor patch
menu "SUNXI_MPP version"
config SUNXI_MPP_VERSION_MAJOR
    int "SUNXI_MPP package major version"
    default 1
    help
      SUNXI_MPP package major version, 0 means auto select according to board

config SUNXI_MPP_VERSION_MINOR
    int "SUNXI_MPP package minor version"
    default 0
    help
      SUNXI_MPP package minor version

config SUNXI_MPP_VERSION_PATCH
    int "SUNXI_MPP package patch version"
    default 1
    help
      SUNXI_MPP package patch version
endmenu
```

## components/3rd_party/websocket/Kconfig
```kconfig
config WEBSOCKET_USE_BOOST_ASIO
	bool "Use boost asio for websocket or use standalone asio library"
	default n
	help
	  If you want to use boost library for websocket, please select y.
```
