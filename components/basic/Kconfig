## components/basic/Kconfig
```kconfig
menu "Basic config"
config OMP_ENABLE
    bool "Enable omp"
    default n if PLATFORM = "maixcam"
    default y if PLATFORM = "maixcam2"
    help
        Enable OMP to accelerate performance on multi-core platforms.
config OMP_ENABLE_DYNAMIC
    bool "Enable omp dynamic"
    default n if PLATFORM = "maixcam"
    default n if PLATFORM = "maixcam2"
    depends on OMP_ENABLE
    help
        Enable or disable dynamic adjustment of the number of threads in a parallel region

config OMP_THREAD_NUMBER
    int "Config omp thread number"
    default 1 if PLATFORM = "maixcam"
    default 2 if PLATFORM = "maixcam2"
    depends on OMP_ENABLE
    help
        Set the number of threads that will be used in parallel regions
endmenu
```

## components/maixcam_lib/Kconfig
```kconfig
menu "runtime lib options"
config MAIXCAM_LIB_COMPILE_FROM_SOURCE
	bool "compile maixcam_lib from souce code"
	default y
	help
	  push source code in src dir and select this option will compile maixcam_lib from source instead of use libs

if MAIXCAM_LIB_COMPILE_FROM_SOURCE
config MAIXCAM_LIB_ENC
  bool "enc maixcam_lib"
  default n
  help
    enc maixcam lib, for internal debug usage
endif

if PLATFORM = "maixcam2"
config MAIXCAM_LOAD_SENSOR_LIBRARY_WITHOUT_DLOPEN
  bool "load libsns_xxx.so without dlopen"
  default n
  select AX620E_MSP_ENABLE_EXTRA_SENSOR_LIB
  help
    Don't call dlopen function to load libsns_xxx.so
endif
endmenu
```

## components/nn/Kconfig
```kconfig
menu "nn component configuration"
config NN_ENABLE
    bool # not visable in menuconfig, just for dependency use.
    default y
    select AX620E_MSP_ENABLE_NPU_LIB if PLATFORM = "maixcam2"
    help
      To use this component, you must enable it here.
endmenu
```

## components/vision/Kconfig
```kconfig
menu "vision component configuration"
config VISION_ENABLE
    bool # not visable in menuconfig, just for dependency use.
    default y
    select AX620E_MSP_ENABLE_NPU_LIB    if PLATFORM = "maixcam2"
    select AX620E_MSP_ENABLE_SENSOR_LIB if PLATFORM = "maixcam2"
    select AX620E_MSP_ENABLE_VO_LIB     if PLATFORM = "maixcam2"
    help
      To use this component, you must enable it here.
endmenu
```

## examples/camera_onvif_server/main/Kconfig
```kconfig
menu "gsoap component configuration"
    menu "GSOAP version"
        config GSOAP_VERSION_MAJOR
            int "GSOAP version major"
            default 2
        config GSOAP_VERSION_MINOR
            int "GSOAP version minor"
            default 8
        config GSOAP_VERSION_PATCH
            int "GSOAP version patch"
            default 92
    endmenu
endmenu
```

## examples/maixcdk-example/maixcdk-example/Kconfig
```kconfig
config PYTHON_PKG_EXAMPLE_CONFIG1
    bool "config from component maixcdk-example, a MaixCDK component installed by pip"
    default n
    help
      component installed by pip as a python package from pypi.org,
      installed by pip install maixcdk-xxxx, more info read documentation.
```
