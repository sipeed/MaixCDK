## examples/nn_yolo26_depth/main/Kconfig
```kconfig
menu "Main Component Config"
    config MAIN_COMPONENT_EACH_BUILD
        bool "Each component build a separate shared library file"
        default n

    config MAIN_COMPONENT_BUILD_TYPE
        string "Main component build type"
        default "Release"
endmenu
```
